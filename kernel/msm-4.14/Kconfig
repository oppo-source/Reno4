## kernel/msm-4.14/Kconfig
```kconfig
# SPDX-License-Identifier: GPL-2.0
#
# For a description of the syntax of this configuration file,
# see Documentation/kbuild/kconfig-language.txt.
#
mainmenu "Linux/$ARCH $KERNELVERSION Kernel Configuration"

config SRCARCH
	string
	option env="SRCARCH"

source "arch/$SRCARCH/Kconfig"

#ifdef VENDOR_EDIT
#Cong.Dai@Bsp.Kernel.Stability, 2020/04/02, Add for aging test, slub debug config
config OPPO_AGING_TEST
	string
	option env="OPPO_AGING_TEST"

config OPPO_KASAN_TEST
	string
	option env="OPPO_KASAN_TEST"

config OPPO_KMEMLEAK_TEST
	string
	option env="OPPO_KMEMLEAK_TEST"

config OPPO_SLUB_TEST
	string
	option env="OPPO_SLUB_TEST"

config OPPO_PAGEOWNER_TEST
	string
	option env="OPPO_PAGEOWNER_TEST"

config OPPO_AGING_DEBUG
	bool "oppo aging config"
	select DEBUG_SPINLOCK
	select DEBUG_MUTEXES
	select IPC_LOGGING
	select QCOM_RTB
	select QCOM_RTB_SEPARATE_CPUS
	select DEBUG_LIST
	select SCSI_LOGGING
	select SCSI_UFSHCD_CMD_LOGGING
	select KPROBES
	default y if OPPO_AGING_TEST = "true"
	default n

config OPPO_KASAN_DEBUG
	bool "oppo kasan debug"
	select KASAN
	select KASAN_EXTRA
	select KCOV
	default y if OPPO_KASAN_TEST = "true"
	default n

config OPPO_KMEMLEAK_DEBUG
	bool "oppo kmemleak debug"
	select DEBUG_KMEMLEAK
	default y if OPPO_KMEMLEAK_TEST = "true"
	default n

config OPPO_SLUB_DEBUG
	bool "oppo slub debug"
	select SLUB_DEBUG
	select SLUB_DEBUG_ON
	select SLUB_DEBUG_PANIC_ON
	default y if OPPO_SLUB_TEST = "true"
	default n

config OPPO_PAGEOWNER_DEBUG
	bool "oppo pageowner debug"
	select PAGE_OWNER
	select PAGE_OWNER_ENABLE_DEFAULT
	default y if OPPO_PAGEOWNER_TEST = "true"
	default n
#endif
```

## kernel/msm-4.14/drivers/soc/oppo/Kconfig
```kconfig
config OPPO_ARCH_FILE
  bool "for build directory oppo"
  ---help---
  say Y to buid in

config OPPO_COMMON_SOFT
  bool "config oppo common software"
  select OPPO_ARCH_FILE
  help
  define this config to get project verion from sharemem.
  Maybe this value is from CDT or dynamic identify by hardware
  id.

config OPPO_DEVICE_IFNO
  bool "config oppo devinfo"
  select OPPO_ARCH_FILE
  help
	define this config to compile devinfo.c for device register
		.

#ifdef VENDOR_EDIT
#/* Yu.Kun@CN.NFC.Basic.Hardware, 2020/03/24, Add for oppo nfc chipset */
config OPPO_NFC
  bool "config oppo nfc chipset"
  select OPPO_ARCH_FILE
  help
	define this config to get nfc chipset version from dts.
#endif /* VENDOR_EDIT */

source "drivers/soc/oppo/project_info/Kconfig"
source "drivers/soc/oppo/device_info/Kconfig"
source "drivers/soc/oppo/force_dump/Kconfig"

#LiPing-M@PSW.MultiMedia.MediaServer, 2020/03/20, Add for kevent feedback
source "drivers/soc/oppo/oppo_kevent_feedback/Kconfig"
#endif /* VENDOR_EDIT */
#modem crash info save
source "drivers/soc/oppo/oppo_mdmrst/Kconfig"

# ifdef VENDOR_EDIT
source "drivers/soc/oppo/oppo_hypnus/Kconfig"
#endif /*VENDOR_EDIT*/

#//Wen.Luo@BSP
#Liang.Zhang@TECH.Storage.Stability.OPPO_SHUTDOWN_DETECT, 2019/04/28, Add for shutdown detect
source "drivers/soc/oppo/oppo_shutdown_detect/Kconfig"

#Kun.Hu@TECH.BSP.Stability.PHOENIX_PROJECT 2019/06/15, Add for PHOENIX_PROJECT
source "drivers/soc/oppo/oppo_phoenix/Kconfig"

#ifdef VENDOR_EDIT
#//wenbin.liu@PSW.Kernel.MM, 2018/05/23, Add for Healthinfo monitor
source "drivers/soc/oppo/oppo_healthinfo/Kconfig"
#endif /* VENDOR_EDIT */

#ifdef VENDOR_EDIT
#/* Yu.Kun@CN.NFC.Basic.Hardware, 2020/03/24, Add for oppo nfc chipset */
source "drivers/soc/oppo/oppo_nfc/Kconfig"
#endif /* VENDOR_EDIT */
```
